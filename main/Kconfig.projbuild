## main/Kconfig.projbuild
```kconfig
menu "Desktop"

    config DESKTOP_WIFI_SSID
        string "WiFi SSID"
        default ""

    config DESKTOP_WIFI_PASSWORD
        string "WiFi password"
        default ""

    config DESKTOP_LAT
        string "Weather latitude"
        default "22.5455"

    config DESKTOP_LON
        string "Weather longitude"
        default "114.0683"

    config DESKTOP_MEDIA_HOST
        string "media-web host or IP"
        default "192.168.1.100"

    config DESKTOP_MEDIA_USER
        string "media-web user"
        default ""

    config DESKTOP_MEDIA_PASSWORD
        string "media-web password"
        default ""

    config DESKTOP_OTA_URL
        string "OTA manifest URL (empty = disabled)"
        default ""
        help
            JSON manifest: {"project":"nicemcu-desktop","version":"0.3.1",
            "url":"http://host/app.bin"}

    config DESKTOP_OTA_CHECK_DELAY_S
        int "Seconds after WiFi connect before OTA check"
        default 15
        range 0 600

    config DESKTOP_HTTP_TOKEN
        string "Local HTTP API token (empty = API disabled)"
        default ""

endmenu
```

## sdkconfig.defaults
```kconfig
CONFIG_IDF_TARGET="esp32s3"
CONFIG_ESPTOOLPY_FLASHSIZE_16MB=y
CONFIG_ESP_DEFAULT_CPU_FREQ_MHZ_240=y
CONFIG_FREERTOS_HZ=1000
CONFIG_ESP_MAIN_TASK_STACK_SIZE=16384
CONFIG_PARTITION_TABLE_CUSTOM=y
CONFIG_PARTITION_TABLE_CUSTOM_FILENAME="partitions.csv"
CONFIG_PARTITION_TABLE_FILENAME="partitions.csv"
CONFIG_LV_MEM_SIZE=73728
CONFIG_LV_FONT_MONTSERRAT_14=y
CONFIG_LV_BUILD_EXAMPLES=n
CONFIG_MBEDTLS_CERTIFICATE_BUNDLE=y
CONFIG_MBEDTLS_CERTIFICATE_BUNDLE_DEFAULT_FULL=y
CONFIG_LWIP_IPV6=n
CONFIG_LV_FONT_MONTSERRAT_32=y
CONFIG_BOOTLOADER_APP_ROLLBACK_ENABLE=y
CONFIG_ESP_HTTPS_OTA_ALLOW_HTTP=y
CONFIG_ESP_COREDUMP_ENABLE_TO_NONE=y
CONFIG_SPIRAM=y
CONFIG_SPIRAM_MODE_OCT=y
CONFIG_SPIRAM_SPEED_80M=y
CONFIG_SPIRAM_USE_MALLOC=y
CONFIG_ESP_WIFI_SOFTAP_SUPPORT=y
```
